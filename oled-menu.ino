#include <SPI.h>
#include <Wire.h>
#include <Adafruit_GFX.h>
#include <Adafruit_SSD1306.h>

#include <SPI.h>
#include <Wire.h>
#include <Adafruit_GFX.h>
#include <Adafruit_SSD1306.h>

#define SCREEN_WIDTH 128 // OLED display width, in pixels
#define SCREEN_HEIGHT 64 // OLED display height, in pixels

// Declaration for an SSD1306 display connected to I2C (SDA, SCL pins)
// The pins for I2C are defined by the Wire-library. 
// On an arduino UNO:       A4(SDA), A5(SCL)
// On an arduino MEGA 2560: 20(SDA), 21(SCL)
// On an arduino LEONARDO:   2(SDA),  3(SCL), ...
#define OLED_RESET     -1 // Reset pin # (or -1 if sharing Arduino reset pin)
#define SCREEN_ADDRESS 0x3c ///< See datasheet for Address; 0x3D for 128x64, 0x3C for 128x32
Adafruit_SSD1306 display(SCREEN_WIDTH, SCREEN_HEIGHT, &Wire, OLED_RESET);

// #define NUMFLAKES     10 // Number of snowflakes in the animation example

// #define LOGO_HEIGHT   16
// #define LOGO_WIDTH    16

static const unsigned char PROGMEM adhyasta_logo [] =
{ 0x00, 0x00, 0x00, 0x00, 0x00, 0x00, 0x00, 0x00, 0x00, 0x00, 0x00, 0x00, 0x00, 0x00, 0x00, 0x00, 
	0x00, 0x00, 0x00, 0x00, 0x00, 0x00, 0x00, 0x00, 0x00, 0x00, 0x00, 0x00, 0x00, 0x00, 0x00, 0x00, 
	0x00, 0x00, 0x00, 0x00, 0x00, 0x00, 0x00, 0x00, 0x00, 0x00, 0x00, 0x00, 0x00, 0x00, 0x00, 0x00, 
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	0x00, 0x00, 0x00, 0x00, 0x00, 0x00, 0x00, 0x00, 0x00, 0x00, 0x00, 0x00, 0x00, 0x00, 0x00, 0x00
};

// ' border-selected', 128x21px
const unsigned char border_selected [] PROGMEM = {
	0x3f, 0xff, 0xff, 0xff, 0xff, 0xff, 0xff, 0xff, 0xff, 0xff, 0xff, 0xff, 0xff, 0xff, 0xff, 0x80, 
	0x40, 0x00, 0x00, 0x00, 0x00, 0x00, 0x00, 0x00, 0x00, 0x00, 0x00, 0x00, 0x00, 0x00, 0x00, 0x40, 
	0xc0, 0x00, 0x00, 0x00, 0x00, 0x00, 0x00, 0x00, 0x00, 0x00, 0x00, 0x00, 0x00, 0x00, 0x00, 0x20, 
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	0x3f, 0xff, 0xff, 0xff, 0xff, 0xff, 0xff, 0xff, 0xff, 0xff, 0xff, 0xff, 0xff, 0xff, 0xff, 0x80
};

// ' icon_analysis', 16x16px
const unsigned char icon_analysis [] PROGMEM = {
	0x1f, 0x00, 0x20, 0x80, 0x40, 0x40, 0x80, 0x20, 0x80, 0x20, 0x80, 0x20, 0x80, 0x20, 0x80, 0x20, 
	0x40, 0x40, 0x20, 0xe0, 0x1f, 0x70, 0x00, 0x38, 0x00, 0x1c, 0x00, 0x0e, 0x00, 0x06, 0x00, 0x00
};
// ' icon_battery', 16x16px
const unsigned char icon_battery [] PROGMEM = {
	0x07, 0xe0, 0xfc, 0x3f, 0x81, 0x81, 0xbf, 0xfd, 0xbf, 0xfd, 0x80, 0x01, 0xbf, 0xfd, 0xbf, 0xfd, 
	0x80, 0x01, 0xbf, 0xfd, 0xbf, 0xfd, 0x80, 0x01, 0xbf, 0xfd, 0xbf, 0xfd, 0x80, 0x01, 0xff, 0xff
};
// ' icon_camera', 16x16px
const unsigned char icon_camera [] PROGMEM = {
	0x00, 0x00, 0x07, 0x80, 0x08, 0x40, 0x10, 0x2e, 0x7f, 0xfe, 0x80, 0x01, 0x83, 0xc5, 0x86, 0x61, 
	0x8c, 0x31, 0x88, 0x11, 0x88, 0x11, 0x8c, 0x31, 0x86, 0x61, 0x83, 0xc1, 0x80, 0x01, 0x7f, 0xfe
};
// ' icon_compass', 16x16px
const unsigned char icon_compass [] PROGMEM = {
	0x01, 0x80, 0x01, 0x80, 0x02, 0xc0, 0x02, 0xc0, 0x04, 0xe0, 0x04, 0xe0, 0x08, 0xf0, 0x08, 0xf0, 
	0x10, 0xf8, 0x10, 0xf8, 0x20, 0xfc, 0x21, 0xfc, 0x46, 0x7e, 0x58, 0x1e, 0xe0, 0x07, 0x80, 0x01
};
// ' icon_dashboard', 16x16px
const unsigned char icon_dashboard [] PROGMEM = {
	0x7f, 0xfe, 0x80, 0x01, 0x86, 0x01, 0x86, 0x01, 0x86, 0x19, 0x86, 0x19, 0xb6, 0x19, 0xb6, 0x19, 
	0xb6, 0xd9, 0xb6, 0xd9, 0x80, 0x01, 0xff, 0xff, 0x7f, 0xfe, 0x01, 0x80, 0x07, 0xe0, 0x0f, 0xf0
};
// ' icon_image', 16x16px
const unsigned char icon_image [] PROGMEM = {
	0xff, 0xff, 0x80, 0x01, 0xbf, 0xfd, 0xa0, 0x05, 0xa1, 0x0d, 0xa2, 0x95, 0xa4, 0x65, 0xa8, 0x25, 
	0xb0, 0x15, 0xa0, 0x05, 0xa0, 0x05, 0xbf, 0xfd, 0x80, 0x01, 0x80, 0x01, 0x80, 0x01, 0xff, 0xff
};
// ' icon_plane', 16x16px
const unsigned char icon_plane [] PROGMEM = {
	0x01, 0x80, 0x01, 0x80, 0x03, 0xc0, 0x03, 0xc0, 0x03, 0xc0, 0x07, 0xe0, 0x1f, 0xf8, 0x7f, 0xfe, 
	0xff, 0xff, 0x01, 0x80, 0x01, 0x80, 0x01, 0x80, 0x01, 0x80, 0x03, 0xc0, 0x0e, 0x70, 0x1c, 0x38
};
// ' icon_speedometer', 16x16px
const unsigned char icon_speedometer [] PROGMEM = {
	0x03, 0xc0, 0x1c, 0x38, 0x20, 0x04, 0x52, 0x42, 0x48, 0x12, 0x84, 0x01, 0xa2, 0x05, 0x81, 0x81, 
	0x81, 0x81, 0xa0, 0x05, 0x80, 0x01, 0x50, 0x0a, 0x45, 0xa2, 0x21, 0x84, 0x1d, 0xb8, 0x03, 0xc0
};
// ' icon_stitching', 16x16px
const unsigned char icon_stitching [] PROGMEM = {
	0xfe, 0x3f, 0x82, 0x21, 0x84, 0x41, 0x88, 0x81, 0x84, 0x41, 0x82, 0x21, 0x84, 0x41, 0x88, 0x81, 
	0x84, 0x41, 0x82, 0x21, 0x84, 0x41, 0x88, 0x81, 0x84, 0x41, 0x82, 0x21, 0x84, 0x41, 0xf8, 0xff
};
// ' icon_terminal', 16x16px
const unsigned char icon_terminal [] PROGMEM = {
	0x00, 0x00, 0x60, 0x00, 0x70, 0x00, 0x38, 0x00, 0x1c, 0x00, 0x0e, 0x00, 0x07, 0x00, 0x03, 0x80, 
	0x03, 0x80, 0x07, 0x00, 0x0e, 0x00, 0x1c, 0x00, 0x38, 0x00, 0x70, 0xff, 0x60, 0xff, 0x00, 0x00
};
// ' icon_tracker', 16x16px
const unsigned char icon_tracker [] PROGMEM = {
	0x00, 0x0c, 0x38, 0x1c, 0x2c, 0x38, 0x26, 0x70, 0x23, 0x60, 0x21, 0x80, 0x20, 0xc0, 0x30, 0x60, 
	0x30, 0x30, 0x1c, 0x18, 0x0f, 0xfc, 0x01, 0x80, 0x02, 0x40, 0x3c, 0x3c, 0x40, 0x02, 0xff, 0xff
};
// ' icon_unet', 16x16px
const unsigned char icon_unet [] PROGMEM = {
	0x78, 0x1e, 0x78, 0x04, 0x30, 0x04, 0x30, 0x04, 0x30, 0x04, 0x30, 0x04, 0x30, 0x04, 0x30, 0x04, 
	0x30, 0x04, 0x30, 0x04, 0x30, 0x04, 0x30, 0x04, 0x30, 0x04, 0x18, 0x18, 0x0f, 0xf0, 0x03, 0xc0
};

// Array of all bitmaps for convenience. (Total bytes used to store images in PROGMEM = 576)
const int epd_bitmap_allArray_LEN = 12;
const unsigned char* menu_icons[12] = {
	icon_analysis,
	icon_battery,
	icon_camera,
	icon_compass,
	icon_dashboard,
	icon_image,
	icon_plane,
	icon_speedometer,
	icon_stitching,
	icon_terminal,
	icon_tracker,
	icon_unet
};

const int NUM_ITEMS = 12;
const int MAX_ITEM_LENGTH = 20; // Max character

char menu_titles[NUM_ITEMS] [MAX_ITEM_LENGTH] = {
  {"Analysis"},
  {"Battery"},
  {"Camera"},
  {"Compass"},
  {"Dashboard"},
  {"Image"},
  {"UAV"},
  {"Speedometer"},
  {"Stitching"},
  {"Terminal"},
  {"Telemetry"},
  {"Segmentation"},
};

#define BUTTON_JOYSTICK 18

int button_clicked; // Only perform action when button is clicked, and wait until another process

int item_selected; // Which item in the menu is selected
int item_prev; // Prev item
int item_next; // Next item

void draw() {
  display.clearDisplay();

  // display.drawBitmap(0, 0, logo_bmp, 128, 64, 1);
  display.display();
  delay(1000);
}

void printBold(int x, int y, const char* text) {
  display.setTextColor(SSD1306_WHITE);
  for (int i = 0; i <= 1; i++) {
    for (int j = 0; j <= 1; j++) {
      display.setCursor(x + i, y + j);
      display.println(text);
    }
  }
}

void setup() {
  Serial.begin(9600);

  // SSD1306_SWITCHCAPVCC = generate display voltage from 3.3V internally
  if(!display.begin(SSD1306_SWITCHCAPVCC, SCREEN_ADDRESS)) {
    Serial.println(F("SSD1306 allocation failed"));
    for(;;); // Don't proceed, loop forever
  }

  pinMode(BUTTON_JOYSTICK, INPUT_PULLUP);

  button_clicked = 0;
  item_selected = 0;

  display.clearDisplay();
  display.drawBitmap(0, 0, adhyasta_logo, 128, 64, 1); // Show the Adhyasta logo
  display.display();
  sleep(2);
}

void loop() {
  // static int last_button_state = HIGH;

  int button_state = digitalRead(BUTTON_JOYSTICK);
  if ((button_state == LOW) && (button_clicked == 0)) {
    item_selected = item_selected + 1;
    // button_clicked = 1; // Temporarily set the state of the button to 1
    if (item_selected >= NUM_ITEMS) { // If first item is selected, "prev item" is the "last item"
      item_selected = 0;
    }
    button_clicked = 1;
  }

  if ((digitalRead(BUTTON_JOYSTICK) == HIGH) && (button_clicked == 1)) {
    button_clicked = 0; // Reset the button's state into 0
  }

  item_prev = item_selected - 1;
  if (item_prev < 0) {
    item_prev = NUM_ITEMS - 1;
  }
  item_next = item_selected + 1;
  if (item_next >= NUM_ITEMS) {
    item_next = 0;
  }


  // Draw the selected border
  display.clearDisplay();

  display.setTextSize(1);
  display.setTextColor(SSD1306_WHITE);

  display.drawBitmap(0, 22, border_selected, 128, 21, 1);

  display.drawBitmap(4, 2, menu_icons[item_prev], 16, 16, 1);
  display.setCursor(22, 2+4); // Add an offset of 4 px
  display.println(menu_titles[item_prev]);

  display.drawBitmap(4, 24, menu_icons[item_selected], 16, 16, 1);
  display.setCursor(22, 24+4); // Add an offset of 4 px
  display.println(menu_titles[item_selected]);
  // printBold(22, 24, menu_titles[item_selected]);

  display.drawBitmap(4, 46, menu_icons[item_next], 16, 16, 1);
  display.setCursor(22, 46+4); // Add an offset of 4 px
  display.println(menu_titles[item_next]);

  display.display();
  delay(100);

  // while (true) {
  //   display.clearDisplay();
  //   display.drawBitmap(0, 0, pictures[0], 128, 64, 1);
  //   display.display();
  //   sleep(2);
  //   display.clearDisplay();
  //   display.drawBitmap(0, 0, pictures[1], 128, 64, 1);
  //   display.display();
  //   sleep(2);
  // }
}